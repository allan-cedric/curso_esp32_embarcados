## DAC/dac-lab/main/Kconfig.projbuild
```kconfig
menu "DAC Example Configuration"

    orsource "$IDF_PATH/examples/common_components/env_caps/$IDF_TARGET/Kconfig.env_caps"

    choice DAC_WAVE
        prompt "DAC Wave type"
        default DAC_WAVE_ONESHOT
        help
            Select a DAC Wave type: Oneshot, Cosine or Saw.

        config DAC_WAVE_ONESHOT
            bool "ONESHOT"
        config DAC_WAVE_COS
            bool "COS"
    endchoice

    choice DAC_WAVE_ONESHOT_TYPE
        depends on DAC_WAVE_ONESHOT
        prompt "DAC Wave Oneshot type"
        default DAC_WAVE_TRIANGULAR
        help
            Select a DAC Oneshot Wave type: Triangular or Saw.

        config DAC_WAVE_TRIANGULAR
            bool "TRIANGULAR"
        config DAC_WAVE_SAW
            bool "SAW"
    endchoice

    choice DAC_CHANNEL
        prompt "DAC Channel"
        default DAC_CHANNEL_0
        help
            Select a DAC Oneshot Wave type: Triangular or Saw.

        config DAC_CHANNEL_0
            bool "0"
        config DAC_CHANNEL_1
            bool "1"
    endchoice

    config DAC_WAVE_COS_FREQ_HZ
        depends on DAC_WAVE_COS
        int "DAC Wave Cosine Frequency (Hz)"
        range 0 2000
        default 1000
        help
            DAC Wave Cosine Frequency (Hz)

    config DAC_WAVE_COS_OFFSET
        depends on DAC_WAVE_COS
        int "DAC Wave Cosine Offset"
        range 0 127
        default 0
        help
            DAC Wave Cosine Offset
endmenu
```

## FreeRTOS/evt-groups/sdkconfig.defaults
```kconfig
CONFIG_ESP_CONSOLE_USB_CDC=y
CONFIG_ESPTOOLPY_FLASHSIZE_4MB=y
CONFIG_ESPTOOLPY_FLASHSIZE="4MB"
```

## SLEEP/lab01-light-sleep-touchpad-wakeup/main/Kconfig.projbuild
```kconfig
menu "Example Configuration"

    choice EXAMPLE_UART_WAKEUP_MODE
        prompt "uart wakeup mode"
        default UART_WK_MODE_ACTIVE_THRESH
        help
            Uart wakeup MODE_ACTIVE_THRESH | MODE_FIFO_THRESH | MODE_START_BIT | MODE_CHAR_SEQ to be selected
            for uart wakeup during light sleep. Specifically, wakeup MODE_ACTIVE_THRESH doesn't require a clock.
            In contrast, the other three wakeup modes need XTAL (not RC FAST for instability) ungated during light
            sleep, where the chips used should support sleep clock icg control. However, they consume more power
            as XTAL must be powered on.

        config UART_WK_MODE_ACTIVE_THRESH
            bool "MODE_ACTIVE_THRESH"
        config UART_WK_MODE_FIFO_THRESH
            bool "MODE_FIFO_THRESH"
            depends on SOC_UART_WAKEUP_SUPPORT_FIFO_THRESH_MODE && SOC_PM_SUPPORT_PMU_CLK_ICG && SOC_PMU_SUPPORTED
        config UART_WK_MODE_START_BIT
            bool "MODE_START_BIT"
            depends on SOC_UART_WAKEUP_SUPPORT_START_BIT_MODE && SOC_PM_SUPPORT_PMU_CLK_ICG && SOC_PMU_SUPPORTED
        config UART_WK_MODE_CHAR_SEQ
            bool "MODE_CHAR_SEQ"
            depends on SOC_UART_WAKEUP_SUPPORT_CHAR_SEQ_MODE && SOC_PM_SUPPORT_PMU_CLK_ICG && SOC_PMU_SUPPORTED
    endchoice

    config EXAMPLE_UART_WAKEUP_MODE_SELCTED
        int
        default 0 if UART_WK_MODE_ACTIVE_THRESH
        default 1 if UART_WK_MODE_FIFO_THRESH
        default 2 if UART_WK_MODE_START_BIT
        default 3 if UART_WK_MODE_CHAR_SEQ

    choice EXAMPLE_TOUCH_SLP_WAKEUP
        prompt "Touch Sensor wakeup level"
        default EXAMPLE_TOUCH_LIGHT_SLEEP_WAKEUP
        help
            Select the touch sensor can wakeup from light sleep or deep sleep.

        config EXAMPLE_TOUCH_LIGHT_SLEEP_WAKEUP
            bool "Light sleep wakeup"
        config EXAMPLE_TOUCH_DEEP_SLEEP_WAKEUP
            bool "Deep sleep wakeup"
    endchoice

    config EXAMPLE_TOUCH_DEEP_SLEEP_PD
        prompt "Allow touch sensor power down during the deep sleep"
        bool
        depends on EXAMPLE_TOUCH_DEEP_SLEEP_WAKEUP && !IDF_TARGET_ESP32
        default "n"
        help
            Whether to allow the touch sensor power down during the deep sleep.
            If enabled, the touch sensor will be powered down during the deep sleep,
            only one specified touch channel can wakeup the chip from deep sleep.
            If disabled, the touch sensor will keep working during the deep sleep,
            any enabled touch channel can wakeup the chip from deep sleep.

endmenu
```

## USB/tusb_keyboard/sdkconfig.defaults
```kconfig
CONFIG_ESP_CONSOLE_USB_CDC=y
CONFIG_ESPTOOLPY_FLASHSIZE_4MB=y
CONFIG_ESPTOOLPY_FLASHSIZE="4MB"
CONFIG_TINYUSB_HID_COUNT=1
CONFIG_TINYUSB_TASK_STACK_SIZE=4096
```
