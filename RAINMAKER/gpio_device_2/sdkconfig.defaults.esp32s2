## RAINMAKER/gpio_device_2/sdkconfig.defaults.esp32s2
```kconfig
#
# Bluetooth
#
CONFIG_BT_ENABLED=n

CONFIG_ESP_CONSOLE_USB_CDC=y
CONFIG_ESPTOOLPY_FLASHSIZE_4MB=y
CONFIG_ESPTOOLPY_FLASHSIZE="4MB"

CONFIG_ESP_INSIGHTS_ENABLED=y
CONFIG_ESP_INSIGHTS_CMD_RESP_ENABLED=y
CONFIG_ESP_RMAKER_ENABLE_CHALLENGE_RESPONSE=n
```

## debugging/debugging_gdbstub/sdkconfig.defaults
```kconfig
#
# GDB Stub
#
CONFIG_ESP_SYSTEM_GDBSTUB_RUNTIME=y
CONFIG_ESP_GDBSTUB_SUPPORT_TASKS=y
CONFIG_ESP_GDBSTUB_MAX_TASKS=32
# end of GDB Stub

# ESP32-S2
CONFIG_ESP_CONSOLE_USB_CDC=y
CONFIG_ESPTOOLPY_FLASHSIZE_4MB=y
CONFIG_ESPTOOLPY_FLASHSIZE="4MB"
```

## delta-ota/sdkconfig.defaults
```kconfig
CONFIG_ESPTOOLPY_FLASHSIZE_4MB=y
CONFIG_PARTITION_TABLE_CUSTOM=y
CONFIG_PARTITION_TABLE_CUSTOM_FILENAME="partitions.csv"
CONFIG_PARTITION_TABLE_FILENAME="partitions.csv"
CONFIG_EXAMPLE_WIFI_SSID_PWD_FROM_STDIN=y
CONFIG_EXAMPLE_CONNECT_IPV6=n

# ESP32-S2
CONFIG_ESP_CONSOLE_USB_CDC=y
CONFIG_ESPTOOLPY_FLASHSIZE_4MB=y
CONFIG_ESPTOOLPY_FLASHSIZE="4MB"
```
